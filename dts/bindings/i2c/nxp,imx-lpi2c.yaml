## dts/bindings/i2c/nxp,imx-lpi2c.yaml
```yaml
# Copyright (c) 2019, NXP
# SPDX-License-Identifier: Apache-2.0

description: NXP i.MX LPI2C controller

compatible: "nxp,imx-lpi2c"

include: i2c-controller.yaml

properties:
    reg:
      required: true

    interrupts:
      required: true

    bus-idle-timeout:
      required: false
      type: int
      description: Bus idle timeout in nanoseconds

    scl-gpios:
      type: phandle-array
      required: false
      description: SCL GPIO pin (optional, only used for bus recovery)

    sda-gpios:
      type: phandle-array
      required: false
      description: SDA GPIO pin (optional, only used for bus recovery)
```
